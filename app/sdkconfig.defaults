## app/sdkconfig.defaults
```kconfig
# Custom partitions
CONFIG_PARTITION_TABLE_CUSTOM=y
CONFIG_PARTITION_TABLE_CUSTOM_FILENAME="partitions_example.csv"
CONFIG_PARTITION_TABLE_FILENAME="partitions_example.csv"

# Performance settings
CONFIG_ESP32_DEFAULT_CPU_FREQ_240=y
CONFIG_ESPTOOLPY_FLASHFREQ_80M=y
CONFIG_ESPTOOLPY_FLASHMODE_QIO=y
CONFIG_ESPTOOLPY_FLASHSIZE_4MB=y

# Enable SPIRAM and Rev. 3
CONFIG_ESP32_REV_MIN_3=y
CONFIG_ESP32_SPIRAM_SUPPORT=y
CONFIG_SPIRAM_SPEED_80M=y
CONFIG_SPIRAM_MALLOC_ALWAYSINTERNAL=4096
CONFIG_SPIRAM_MALLOC_RESERVE_INTERNAL=16384

# Debugging
CONFIG_FREERTOS_WATCHPOINT_END_OF_STACK=y
CONFIG_ESP32_PANIC_GDBSTUB=y

# Watchdogs
CONFIG_ESP_TASK_WDT_TIMEOUT_S=15
CONFIG_ESP_INT_WDT_TIMEOUT_MS=1500

# Stack
CONFIG_ESP_MAIN_TASK_STACK_SIZE=18000
```

## main/Kconfig.projbuild
```kconfig
menu "OpenOCD-on-ESP32 Configuration"

    choice OPENOCD_CHOOSE_TARGET_CONFIG
        prompt "OpenOCD target file"
        default OPENOCD_TARGET_ESP32
        help
            Name of the target config file.
            Make sure the config file and its dependencies are located in the tcl-lite directory.

        config OPENOCD_TARGET_ESP32
            bool "esp32"
        config OPENOCD_TARGET_ESP32S2
            bool "esp32s2"
        config OPENOCD_TARGET_ESP32S3
            bool "esp32s3"
        config OPENOCD_TARGET_ESP32C2
            bool "esp32c2"
        config OPENOCD_TARGET_ESP32C3
            bool "esp32c3"
        config OPENOCD_TARGET_ESP32H2
            bool "esp32h2"
        config OPENOCD_TARGET_ESP32C6
            bool "esp32c6"
        config OPENOCD_TARGET_OTHER
            bool "other"
    endchoice

    config OPENOCD_OTHER_TARGET_CONFIG
        string "OpenOCD target file for none Espressif chips"
        depends on OPENOCD_TARGET_OTHER
        default "stm32f1x.cfg"
        help
            Name of the target config file with ".cfg" suffix.
            Make sure the config file and its dependencies are located in the tcl-lite directory.

    config OPENOCD_TARGET_CONFIG_FILE
        string
        default "esp32.cfg" if OPENOCD_TARGET_ESP32
        default "esp32s2.cfg" if OPENOCD_TARGET_ESP32S2
        default "esp32s3.cfg" if OPENOCD_TARGET_ESP32S3
        default "esp32c2.cfg" if OPENOCD_TARGET_ESP32C2
        default "esp32c3.cfg" if OPENOCD_TARGET_ESP32C3
        default "esp32h2.cfg" if OPENOCD_TARGET_ESP32H2
        default "esp32c6.cfg" if OPENOCD_TARGET_ESP32C6
        default OPENOCD_OTHER_TARGET_CONFIG if OPENOCD_TARGET_OTHER

	choice OPENOCD_CHOOSE_INTERFACE
		prompt "OpenOCD interface"
		default OPENOCD_IFACE_JTAG
		help
			Select which transport to use in this OpenOCD session

		config OPENOCD_IFACE_JTAG
			bool "jtag"
		config OPENOCD_IFACE_SWD
			bool "swd"
	endchoice

    config OPENOCD_INTERFACE
        int
        default 0 if OPENOCD_IFACE_JTAG
		default 1 if OPENOCD_IFACE_SWD
        default 0

    choice OPENOCD_CHOOSE_TARGET_FLASH_SIZE
        prompt "OpenOCD target flash size"
        default OPENOCD_TARGET_FLASH_SIZE_AUTO
        depends on !OPENOCD_TARGET_OTHER
        help
            Size of the target flash. '0' to disable flasher stub.

        config OPENOCD_TARGET_FLASH_SIZE_AUTO
            bool "auto"
        config OPENOCD_TARGET_FLASH_SIZE_CUSTOM
            bool "custom"
    endchoice

    config OPENOCD_CUSTOM_TARGET_FLASH_SIZE
        string "Size of the target flash"
        depends on OPENOCD_TARGET_FLASH_SIZE_CUSTOM
        default "0"
        help
            Size of the target flash in hex. "0" to disable flasher stub.

    config ESP_FLASH_SIZE
        string
        default "auto" if OPENOCD_TARGET_FLASH_SIZE_AUTO
        default OPENOCD_CUSTOM_TARGET_FLASH_SIZE if OPENOCD_TARGET_FLASH_SIZE_CUSTOM
        default "auto"

    choice OPENOCD_CHOOSE_RTOS_TYPE
        prompt "OpenOCD rtos type"
        default OPENOCD_RTOS_FREERTOS
        depends on !OPENOCD_TARGET_OTHER
        help
            See supported rtos types in the openocd documentation.
            To disable OS support (for bare metal system) use 'none'.

        config OPENOCD_RTOS_FREERTOS
            bool "FreeRTOS"
        config OPENOCD_RTOS_NUTTX
            bool "nuttx"
        config OPENOCD_RTOS_ZEPHYR
            bool "Zephyr"
        config OPENOCD_RTOS_HWTHREAD
            bool "hwthread"
        config OPENOCD_RTOS_THREADX
            bool "ThreadX"
        config OPENOCD_RTOS_ECOS
            bool "eCos"
        config OPENOCD_RTOS_LINUX
            bool "linux"
        config OPENOCD_RTOS_CHIBIOS
            bool "chibios"
        config OPENOCD_RTOS_CHROMIUM
            bool "Chromium-EC"
        config OPENOCD_RTOS_EMBKERNEL
            bool "embKernel"
        config OPENOCD_RTOS_MQX
            bool "mqx"
        config OPENOCD_RTOS_UCOS
            bool "uCOS-III"
        config OPENOCD_RTOS_RTKERNEL
            bool "rtkernel"
        config OPENOCD_RTOS_NONE
            bool "none"
    endchoice

    config ESP_RTOS
        string
        default "FreeRTOS" if OPENOCD_RTOS_FREERTOS
        default "nuttx" if OPENOCD_RTOS_NUTTX
        default "Zephyr" if OPENOCD_RTOS_ZEPHYR
        default "hwthread" if OPENOCD_RTOS_HWTHREAD
        default "ThreadX" if OPENOCD_RTOS_THREADX
        default "eCos" if OPENOCD_RTOS_ECOS
        default "linux" if OPENOCD_RTOS_LINUX
        default "chibios" if OPENOCD_RTOS_CHIBIOS
        default "Chromium-EC" if OPENOCD_RTOS_CHROMIUM
        default "embKernel" if OPENOCD_RTOS_EMBKERNEL
        default "mqx" if OPENOCD_RTOS_MQX
        default "uCOS-III" if OPENOCD_RTOS_UCOS
        default "rtkernel" if OPENOCD_RTOS_RTKERNEL
        default "none" if OPENOCD_RTOS_NONE
        default "FreeRTOS"

    config OPENOCD_SMP_TARGET
        bool "OpenOCD smp target"
        default y
        depends on OPENOCD_TARGET_ESP32 || OPENOCD_TARGET_ESP32S3

    config ESP_ONLYCPU
        int
        default 3 if OPENOCD_SMP_TARGET
        default 1

    config OPENOCD_CUSTOM_COMMAND
        string "Command line arguments"
        default ""
        help
            OpenOCD -c command

    config OPENOCD_DEBUG_LEVEL
        int "OpenOCD Debug level"
        range 1 4
        default 2
        help
            Sets the verbosity level of debugging output.

    config UI_ENABLE
        bool "Run on ESP-BOX"
        depends on IDF_TARGET_ESP32S3
        default n

    config ESP_WIFI_SSID
        string "WiFi SSID"
        default "esp-openocd"
        help
            SSID (network name) to connect.

    config ESP_WIFI_PASSWORD
        string "WiFi Password"
        default ""
        help
            WiFi password (WPA or WPA2) to use.

endmenu
```

## sdkconfig.defaults
```kconfig
# Custom partitions
CONFIG_PARTITION_TABLE_CUSTOM=y
CONFIG_PARTITION_TABLE_CUSTOM_FILENAME="partitions_example.csv"
CONFIG_PARTITION_TABLE_FILENAME="partitions_example.csv"

# Performance settings
CONFIG_ESPTOOLPY_FLASHSIZE_8MB=y
CONFIG_ESPTOOLPY_FLASHSIZE="8MB"
CONFIG_ESP_DEFAULT_CPU_FREQ_MHZ_240=y
CONFIG_ESPTOOLPY_FLASHFREQ_80M=y
CONFIG_COMPILER_OPTIMIZATION_PERF=y

# Wi-Fi
CONFIG_ESP32_WIFI_STATIC_RX_BUFFER_NUM=4
CONFIG_ESP32_WIFI_DYNAMIC_RX_BUFFER_NUM=128
CONFIG_ESP32_WIFI_STATIC_TX_BUFFER_NUM=4
CONFIG_ESP32_WIFI_CACHE_TX_BUFFER_NUM=128
CONFIG_ESP32_WIFI_RX_BA_WIN=8
CONFIG_ESP32_WIFI_TASK_PINNED_TO_CORE_1=y

# Enable SPIRAM
CONFIG_SPIRAM=y
CONFIG_SPIRAM_SPEED_80M=y
CONFIG_SPIRAM_TRY_ALLOCATE_WIFI_LWIP=y
CONFIG_SPIRAM_MALLOC_ALWAYSINTERNAL=4096
CONFIG_SPIRAM_MALLOC_RESERVE_INTERNAL=16384
CONFIG_SPIRAM_ALLOW_BSS_SEG_EXTERNAL_MEMORY=y

# Debugging
CONFIG_FREERTOS_WATCHPOINT_END_OF_STACK=y
CONFIG_ESP_SYSTEM_PANIC_GDBSTUB=y

# Watchdogs
CONFIG_ESP_TASK_WDT_TIMEOUT_S=15
CONFIG_ESP_INT_WDT_TIMEOUT_MS=1500

# Stack
CONFIG_ESP_MAIN_TASK_STACK_SIZE=32000

# Panic handler
CONFIG_ESP_SYSTEM_GDBSTUB_RUNTIME=y
```
